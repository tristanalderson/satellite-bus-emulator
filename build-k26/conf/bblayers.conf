## build-k26/conf/bblayers.conf
```bitbake
# POKY_BBLAYERS_CONF_VERSION is increased each time build/conf/bblayers.conf
# changes incompatibly
POKY_BBLAYERS_CONF_VERSION = "2"

BBPATH = "${TOPDIR}"
BBFILES ?= ""

BBLAYERS ?= " \
  /home/yocto/yocto-build/poky/meta \
  /home/yocto/yocto-build/poky/meta-poky \
  /home/yocto/yocto-build/poky/meta-yocto-bsp \
  /home/yocto/yocto-build/repos/meta-openembedded/meta-oe \
  /home/yocto/yocto-build/repos/meta-arm/meta-arm-toolchain \
  /home/yocto/yocto-build/repos/meta-arm/meta-arm \
  /home/yocto/yocto-build/repos/meta-xilinx/meta-xilinx-core \
  /home/yocto/yocto-build/repos/meta-xilinx/meta-xilinx-bsp \
  /home/yocto/yocto-build/repos/meta-xilinx/meta-xilinx-standalone \
  /home/yocto/yocto-build/repos/meta-xilinx/meta-microblaze \
  /home/yocto/yocto-build/repos/meta-openamp \
  /home/yocto/yocto-build/repos/meta-openembedded/meta-python \
  /home/yocto/yocto-build/repos/meta-openembedded/meta-networking \
  /home/yocto/yocto-build/repos/meta-openembedded/meta-filesystems \
  /home/yocto/yocto-build/repos/meta-virtualization \
  /home/yocto/yocto-build/repos/meta-xilinx/meta-xilinx-standalone-sdt \
  /home/yocto/yocto-build/repos/meta-kria \
  "
```
